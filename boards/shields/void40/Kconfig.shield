## boards/shields/void40/Kconfig.shield
```kconfig
# Copyright (c) 2025 Alexis Williams
# SPDX-License-Identifier: MIT

config SHIELD_VOID40
    def_bool $(shields_list_contains,void40)
    select LVGL if ZMK_DISPLAY
```

## config/west.yml
```yaml
manifest:
  remotes:
    - name: awkannan
      url-base: https://github.com/awkannan
    - name: cannonkeys
      url-base: https://github.com/cannonkeys
  projects:
    - name: zmk
      remote: awkannan
      revision: 312e4b0a056bcea9615d1355e84a5d1b2927f6ba # develop
      import: app/west.yml
    - name: zmk-gpio-behavior
      remote: awkannan
      revision: 174a055e3c991b28942be71706265bfab4672dd6 # main
    - name: zmk-smart-rgbled-widget
      remote: awkannan
      revision: 8569005c9444eaf32423546504b77fc6b7fa3d20 # main
    - name: zmk-cannonkeys-keyboards
      remote: cannonkeys
      revision: 0b6f02193686573e78a7cb1d6fd768bcf53241d0 # main
  self:
    path: config
```
